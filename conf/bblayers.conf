## conf/bblayers.conf
```bitbake
# POKY_BBLAYERS_CONF_VERSION is increased each time build/conf/bblayers.conf
# changes incompatibly
POKY_BBLAYERS_CONF_VERSION = "2"

BBPATH = "${TOPDIR}"
BBFILES ?= ""

BBLAYERS ?= " \
  /home/stefanny/Pro/poky-warrior/meta \
  /home/stefanny/Pro/poky-warrior/meta-poky \
  /home/stefanny/Pro/poky-warrior/meta-yocto-bsp \
  /home/stefanny/Pro/poky-warrior/meta-openembedded/meta-oe \
  /home/stefanny/Pro/poky-warrior/meta-openembedded/meta-multimedia \
  /home/stefanny/Pro/poky-warrior/meta-openembedded/meta-filesystems \
  /home/stefanny/Pro/poky-warrior/meta-openembedded/meta-networking \
  /home/stefanny/Pro/poky-warrior/meta-openembedded/meta-python \
  /home/stefanny/Pro/poky-warrior/meta-raspberrypi \
  /home/stefanny/Pro/poky-warrior/meta-tensorflow \
  "
```
